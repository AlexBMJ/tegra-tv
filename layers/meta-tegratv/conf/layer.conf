## layers/meta-tegratv/conf/layer.conf
```bitbake
BBPATH =. "${LAYERDIR}:"
BBFILES += "${LAYERDIR}/recipes-*/*/*.bb ${LAYERDIR}/recipes-*/*/*.bbappend"

BBFILE_COLLECTIONS += "tegratv"
BBFILE_PATTERN_tegratv = "^${LAYERDIR}/"
BBFILE_PRIORITY_tegratv = "50"

LAYERVERSION_tegratv = "4"
LAYERSERIES_COMPAT_tegratv = "kirkstone"

# This is used by the tegra-distro-sanity bbclass
# to identify the distro layer directory during
# bblayers checks.
TD_DISTRO_LAYERDIR = "${LAYERDIR}"
```
